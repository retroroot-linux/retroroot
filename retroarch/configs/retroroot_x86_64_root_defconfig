## retroroot/package/dracut/Config.in
```kconfig
config BR2_PACKAGE_DRACUT
	bool "dracut"
	depends on BR2_USE_MMU # fork()
	depends on !BR2_STATIC_LIBS # kmod
	select BR2_PACKAGE_KMOD
	select BR2_PACKAGE_PKGCONF
	select BR2_PACKAGE_BASH_COMPLETION if BR2_PACKAGE_BASH
	help
	  dracut (the tool) is used to create an initramfs image by
	  copying tools and files from an installed system and combining
	  it with the dracut framework, usually found in
	  /usr/lib/dracut/modules.d.

	  https://github.com/dracutdevs/dracut

comment "dracut needs a toolchain w/ dynamic library"
	depends on BR2_USE_MMU
	depends on BR2_STATIC_LIBS
```

## retroroot/package/plymouth/Config.in
```kconfig
config BR2_PACKAGE_PLYMOUTH
	bool "plymouth"
	depends on BR2_TOOLCHAIN_HAS_THREADS # dbus
	depends on BR2_USE_MMU # dbus
	depends on BR2_PACKAGE_HAS_UDEV
	select BR2_PACKAGE_CAIRO
	select BR2_PACKAGE_DBUS
	select BR2_PACKAGE_LIBCAP
	select BR2_PACKAGE_LIBPNG
	help
	  Plymouth is an application that runs very early in the boot
	  process (even before the root filesystem is mounted!) that
	  provides a graphical boot animation while the boot process
	  happens in the background.

	  https://github.com/freedesktop/plymouth

if BR2_PACKAGE_PLYMOUTH

config BR2_PACKAGE_PLYMOUTH_BOOT_LOGO
	string "Path to bootlogo"
	help
	  Specify a path to a bootlogo png.

endif

comment "plymouth needs udev and a toolchain w/ threads"
	depends on BR2_USE_MMU
	depends on !BR2_PACKAGE_HAS_UDEV || !BR2_TOOLCHAIN_HAS_THREADS
```

## retroroot/package/retroarch-assets/Config.in
```kconfig
config BR2_PACKAGE_RETROARCH_ASSETS
	bool "retroarch-assets"
	depends on BR2_PACKAGE_RETROARCH
	help
	  Assets needed for RetroArch - e.g. menu drivers, etc.
	  Also contains the official branding.

	  https://github.com/libretro/retroarch-assets

comment "retroarch needs a toolchain w/ dynamic library, threads, wchar"
	depends on BR2_USE_MMU
	depends on BR2_STATIC_LIBS || !BR2_TOOLCHAIN_HAS_THREADS || !BR2_USE_WCHAR
```

## retroroot/package/retroroot-initrd/Config.in
```kconfig
config BR2_PACKAGE_RETROARCH_INITRD
	bool "retroroot initrd"
	help
	  Initrd files for retroroot.
```
