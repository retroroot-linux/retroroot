## retroroot/configs/raspberrypi4_defconfig
```kconfig
BR2_arm=y
BR2_cortex_a72=y
BR2_ARM_FPU_NEON_VFPV4=y
BR2_DL_DIR="$(TOPDIR)/retroroot/dl"
BR2_GLOBAL_PATCH_DIR="retroroot/board/raspberrypi/common/patches"
BR2_TOOLCHAIN_EXTERNAL=y
BR2_TARGET_GENERIC_HOSTNAME="RetroRoot"
BR2_TARGET_GENERIC_ISSUE="Welcome to RetroRoot"
BR2_INIT_SYSTEMD=y
BR2_SYSTEM_BIN_SH_BASH=y
BR2_SYSTEM_DHCP="eth0"
BR2_SYSTEM_DEFAULT_PATH="/bin:/sbin:/usr/bin:/usr/sbin"
# BR2_ENABLE_LOCALE_PURGE is not set
BR2_SYSTEM_ENABLE_NLS=y
BR2_ROOTFS_OVERLAY="retroroot/board/common/overlay retroroot/board/raspberrypi/common/overlay retroroot/board/raspberrypi/raspberrypi4/overlay"
BR2_ROOTFS_POST_BUILD_SCRIPT="retroroot/board/raspberrypi/raspberrypi4/post-build.sh"
BR2_ROOTFS_POST_IMAGE_SCRIPT="retroroot/board/raspberrypi/raspberrypi4/post-image.sh"
BR2_LINUX_KERNEL=y
BR2_LINUX_KERNEL_CUSTOM_TARBALL=y
BR2_LINUX_KERNEL_CUSTOM_TARBALL_LOCATION="$(call github,raspberrypi,linux,raspberrypi-kernel_1.20210303-1)/raspberrypi-kernel_1.20210303-1.tar.gz"
BR2_LINUX_KERNEL_DEFCONFIG="broadcom/bcm2711"
BR2_LINUX_KERNEL_DTS_SUPPORT=y
BR2_LINUX_KERNEL_INSTALL_TARGET=y
BR2_LINUX_KERNEL_INTREE_DTS_NAME="bcm2711-rpi-4-b"
BR2_LINUX_KERNEL_NEEDS_HOST_OPENSSL=y
BR2_PACKAGE_RPI_FIRMWARE=y
BR2_PACKAGE_RPI_FIRMWARE_VARIANT_PI4=y
BR2_PACKAGE_TSLIB=y
BR2_PACKAGE_COREUTILS=y
BR2_PACKAGE_COREUTILS_INDIVIDUAL_BINARIES=y
BR2_PACKAGE_UTIL_LINUX_LIBFDISK=y
BR2_PACKAGE_NANO=y
BR2_PACKAGE_LESS=y
BR2_TARGET_ROOTFS_EXT2=y
BR2_TARGET_ROOTFS_EXT2_4=y
BR2_TARGET_ROOTFS_EXT2_SIZE="512M"
BR2_TARGET_ROOTFS_INITRAMFS=y
BR2_TARGET_ROOTFS_INITRAMFS_DRACUT=y
# BR2_TARGET_ROOTFS_TAR is not set
BR2_PACKAGE_HOST_DOSFSTOOLS=y
BR2_PACKAGE_HOST_GENIMAGE=y
BR2_PACKAGE_HOST_MTOOLS=y
BR2_PACKAGE_HOST_UBOOT_TOOLS_BOOT_SCRIPT=y
BR2_PACKAGE_HOST_UBOOT_TOOLS_BOOT_SCRIPT_SOURCE="retroroot/board/raspberrypi/common/boot.txt"
```

## retroroot/configs/raspberrypi5_defconfig
```kconfig
BR2_aarch64=y
BR2_cortex_a76=y
BR2_TOOLCHAIN_EXTERNAL=y
BR2_TOOLCHAIN_EXTERNAL_BOOTLIN=y
BR2_DL_DIR="retroroot/dl"
BR2_CCACHE=y
BR2_CCACHE_DIR="/home/ccache/rpi5"
BR2_CCACHE_INITIAL_SETUP="--max-size=5G"
BR2_ENABLE_LTO=y
BR2_GLOBAL_PATCH_DIR="retroroot/board/raspberrypi/hashes"
BR2_DOWNLOAD_FORCE_CHECK_HASHES=y
BR2_PER_PACKAGE_DIRECTORIES=y
BR2_SYSTEM_DHCP="eth0"
BR2_ROOTFS_POST_BUILD_SCRIPT="retroroot/board/raspberrypi/raspberrypi5/post-build.sh"
BR2_ROOTFS_POST_IMAGE_SCRIPT="retroroot/board/raspberrypi/raspberrypi5/post-image.sh"
BR2_ROOTFS_POST_SCRIPT_ARGS="--data-part-size=1024M --device-type=retroroot-rpi5 --generate-mender-image=true --artifact-name=2024.02.9"
BR2_LINUX_KERNEL=y
BR2_LINUX_KERNEL_CUSTOM_TARBALL=y
BR2_LINUX_KERNEL_CUSTOM_TARBALL_LOCATION="$(call github,raspberrypi,linux,576cc10e1ed50a9eacffc7a05c796051d7343ea4)/linux-576cc10e1ed50a9eacffc7a05c796051d7343ea4.tar.gz"
BR2_LINUX_KERNEL_DEFCONFIG="bcm2712"
BR2_LINUX_KERNEL_CONFIG_FRAGMENT_FILES="retroroot/board/raspberrypi/raspberrypi5/linux-4k-page-size.fragment"
BR2_LINUX_KERNEL_DTS_SUPPORT=y
BR2_LINUX_KERNEL_INTREE_DTS_NAME="broadcom/bcm2712-rpi-5-b broadcom/bcm2712d0-rpi-5-b"
BR2_LINUX_KERNEL_NEEDS_HOST_OPENSSL=y
BR2_PACKAGE_BUSYBOX_SHOW_OTHERS=y
BR2_PACKAGE_ALSA_UTILS=y
BR2_PACKAGE_ALSA_UTILS_ALSACONF=y
BR2_PACKAGE_ALSA_UTILS_ACONNECT=y
BR2_PACKAGE_ALSA_UTILS_ALSALOOP=y
BR2_PACKAGE_ALSA_UTILS_ALSAUCM=y
BR2_PACKAGE_ALSA_UTILS_ALSATPLG=y
BR2_PACKAGE_ALSA_UTILS_AMIDI=y
BR2_PACKAGE_ALSA_UTILS_AMIXER=y
BR2_PACKAGE_ALSA_UTILS_APLAY=y
BR2_PACKAGE_ALSA_UTILS_APLAYMIDI=y
BR2_PACKAGE_ALSA_UTILS_ARECORDMIDI=y
BR2_PACKAGE_ALSA_UTILS_ASEQDUMP=y
BR2_PACKAGE_ALSA_UTILS_ASEQNET=y
BR2_PACKAGE_ALSA_UTILS_BAT=y
BR2_PACKAGE_ALSA_UTILS_IECSET=y
BR2_PACKAGE_PULSEAUDIO=y
BR2_PACKAGE_PULSEAUDIO_DAEMON=y
BR2_PACKAGE_XZ=y
BR2_PACKAGE_DEJAVU=y
BR2_PACKAGE_GHOSTSCRIPT_FONTS=y
BR2_PACKAGE_FBSET=y
BR2_PACKAGE_FBTERM=y
BR2_PACKAGE_MESA3D=y
BR2_PACKAGE_MESA3D_GALLIUM_DRIVER_V3D=y
BR2_PACKAGE_MESA3D_OPENGL_GLX=y
BR2_PACKAGE_MESA3D_OPENGL_ES=y
BR2_PACKAGE_XORG7=y
BR2_PACKAGE_B43_FIRMWARE=y
BR2_PACKAGE_BRCMFMAC_SDIO_FIRMWARE_RPI=y
BR2_PACKAGE_BRCMFMAC_SDIO_FIRMWARE_RPI_BT=y
BR2_PACKAGE_LINUX_FIRMWARE=y
BR2_PACKAGE_LINUX_FIRMWARE_BRCM_BCM43XXX=y
BR2_PACKAGE_RPI_FIRMWARE=y
BR2_PACKAGE_RPI_FIRMWARE_CONFIG_FILE="retroroot/board/raspberrypi/raspberrypi5/config.txt"
BR2_PACKAGE_RPI_FIRMWARE_CMDLINE_FILE="retroroot/board/raspberrypi/raspberrypi5/cmdline.txt"
BR2_PACKAGE_BLUEZ5_UTILS=y
BR2_PACKAGE_BLUEZ5_UTILS_OBEX=y
BR2_PACKAGE_BLUEZ5_UTILS_CLIENT=y
BR2_PACKAGE_BLUEZ5_UTILS_DEPRECATED=y
BR2_PACKAGE_BLUEZ5_UTILS_EXPERIMENTAL=y
BR2_PACKAGE_BLUEZ5_UTILS_PLUGINS_HEALTH=y
BR2_PACKAGE_BLUEZ5_UTILS_PLUGINS_MIDI=y
BR2_PACKAGE_BLUEZ5_UTILS_PLUGINS_NFC=y
BR2_PACKAGE_BLUEZ5_UTILS_PLUGINS_SAP=y
BR2_PACKAGE_WIRELESS_REGDB=y
BR2_PACKAGE_KMOD=y
BR2_PACKAGE_KMOD_TOOLS=y
BR2_PACKAGE_MENDER=y
BR2_PACKAGE_MENDER_GRUBENV=y
BR2_PACKAGE_MENDER_GRUBENV_DEFINES="retroroot/board/raspberrypi/raspberrypi5/mender_grubenv_defines"
BR2_TARGET_ROOTFS_EXT2=y
BR2_TARGET_ROOTFS_EXT2_4=y
BR2_TARGET_ROOTFS_EXT2_SIZE="1024M"
BR2_TARGET_ROOTFS_EXT2_MKFS_OPTIONS="-O 64bit"
# BR2_TARGET_ROOTFS_TAR is not set
BR2_TARGET_GRUB2=y
BR2_TARGET_GRUB2_BUILTIN_MODULES_EFI="boot linux ext2 fat serial part_msdos part_gpt normal efi_gop iso9660 configfile search loadenv test cat echo gcry_sha256 halt hashsum sleep reboot regexp loadenv test"
BR2_TARGET_GRUB2_INSTALL_TOOLS=y
BR2_TARGET_UBOOT=y
BR2_TARGET_UBOOT_BUILD_SYSTEM_KCONFIG=y
BR2_TARGET_UBOOT_CUSTOM_VERSION=y
BR2_TARGET_UBOOT_CUSTOM_VERSION_VALUE="2025.01"
BR2_TARGET_UBOOT_BOARD_DEFCONFIG="rpi_arm64"
BR2_TARGET_UBOOT_CONFIG_FRAGMENT_FILES="retroroot/board/raspberrypi/common/kconfig_stubs/fast_uboot"
BR2_TARGET_UBOOT_NEEDS_DTC=y
BR2_TARGET_UBOOT_NEEDS_PYLIBFDT=y
BR2_TARGET_UBOOT_NEEDS_PYELFTOOLS=y
BR2_TARGET_UBOOT_NEEDS_OPENSSL=y
BR2_TARGET_UBOOT_NEEDS_GNUTLS=y
BR2_TARGET_UBOOT_NEEDS_UTIL_LINUX=y
BR2_PACKAGE_HOST_DOSFSTOOLS=y
BR2_PACKAGE_HOST_GENIMAGE=y
BR2_PACKAGE_HOST_KMOD_XZ=y
BR2_PACKAGE_HOST_MENDER_ARTIFACT=y
BR2_PACKAGE_HOST_MTOOLS=y
BR2_PACKAGE_RETROARCH=y
BR2_PACKAGE_RETROARCH_FFMPEG=y
BR2_PACKAGE_RETROARCH_EGL=y
BR2_PACKAGE_RETROARCH_GLES=y
BR2_PACKAGE_RETROARCH_KMS=y
BR2_PACKAGE_RETROARCH_SDL2=y
BR2_PACKAGE_RETROARCH_RGUI_MENU=y
BR2_PACKAGE_RETROARCH_MATERIAUI_MENU=y
BR2_PACKAGE_RETROARCH_XMB_MENU=y
BR2_PACKAGE_RETROARCH_OZONE_MENU=y
BR2_PACKAGE_RETROARCH_ASSETS=y
```

## retroroot/configs/raspberrypizero2w_defconfig
```kconfig
BR2_arm=y
BR2_cortex_a53=y
BR2_ARM_FPU_NEON_VFPV4=y
BR2_TOOLCHAIN_EXTERNAL=y
BR2_DL_DIR="$(TOPDIR)/retroroot/dl"
BR2_CCACHE=y
BR2_CCACHE_DIR="/home/ccache/rpiz2w"
BR2_CCACHE_INITIAL_SETUP="--max-size=5G"
BR2_ENABLE_LTO=y
BR2_GLOBAL_PATCH_DIR="retroroot/board/raspberrypi/hashes"
BR2_DOWNLOAD_FORCE_CHECK_HASHES=y
BR2_PER_PACKAGE_DIRECTORIES=y
BR2_TARGET_GENERIC_HOSTNAME="RetroRoot"
BR2_TARGET_GENERIC_ISSUE="Welcome to RetroRoot"
BR2_INIT_SYSTEMD=y
BR2_SYSTEM_BIN_SH_BASH=y
BR2_SYSTEM_ENABLE_NLS=y
BR2_ROOTFS_OVERLAY="retroroot/board/common/overlay retroroot/board/raspberrypi/common/overlay retroroot/board/raspberrypi/raspberrypizero2w/overlay"
BR2_ROOTFS_POST_BUILD_SCRIPT="retroroot/board/raspberrypi/raspberrypizero2w/post-build.sh"
BR2_ROOTFS_POST_IMAGE_SCRIPT="retroroot/board/raspberrypi/raspberrypizero2w/post-image.sh"
BR2_ROOTFS_POST_SCRIPT_ARGS="--data-part-size=1024M --device-type=retroroot-rpiz2w --generate-mender-image=false --artifact-name=2024.02.9"
BR2_LINUX_KERNEL=y
BR2_LINUX_KERNEL_CUSTOM_TARBALL=y
BR2_LINUX_KERNEL_CUSTOM_TARBALL_LOCATION="$(call github,raspberrypi,linux,576cc10e1ed50a9eacffc7a05c796051d7343ea4)/linux-576cc10e1ed50a9eacffc7a05c796051d7343ea4.tar.gz"
BR2_LINUX_KERNEL_DEFCONFIG="bcm2709"
BR2_LINUX_KERNEL_DTS_SUPPORT=y
BR2_LINUX_KERNEL_INTREE_DTS_NAME="broadcom/bcm2710-rpi-zero-2-w"
BR2_LINUX_KERNEL_NEEDS_HOST_OPENSSL=y
BR2_PACKAGE_VULKAN_TOOLS=y
BR2_PACKAGE_B43_FIRMWARE=y
BR2_PACKAGE_BRCMFMAC_SDIO_FIRMWARE_RPI=y
BR2_PACKAGE_BRCMFMAC_SDIO_FIRMWARE_RPI_BT=y
BR2_PACKAGE_LINUX_FIRMWARE=y
BR2_PACKAGE_LINUX_FIRMWARE_BRCM_BCM43XXX=y
BR2_PACKAGE_RPI_FIRMWARE=y
BR2_PACKAGE_RPI_FIRMWARE_BOOTCODE_BIN=y
BR2_PACKAGE_RPI_FIRMWARE_VARIANT_PI=y
BR2_PACKAGE_RPI_FIRMWARE_CONFIG_FILE="retroroot/board/raspberrypi/raspberrypizero2w/config.txt"
BR2_PACKAGE_RPI_FIRMWARE_CMDLINE_FILE="retroroot/board/raspberrypi/raspberrypizero2w/cmdline.txt"
BR2_TARGET_ROOTFS_EXT2=y
BR2_TARGET_ROOTFS_EXT2_4=y
BR2_TARGET_ROOTFS_EXT2_SIZE="1024M"
# BR2_TARGET_ROOTFS_TAR is not set
BR2_PACKAGE_HOST_GENIMAGE=y
BR2_PACKAGE_HOST_DOSFSTOOLS=y
BR2_PACKAGE_HOST_KMOD_XZ=y
BR2_PACKAGE_HOST_MTOOLS=y
```

## retroroot/configs/x86_64_kms_defconfig
```kconfig
BR2_x86_64=y
BR2_DL_DIR="$(TOPDIR)/retroroot/dl"
BR2_CCACHE=y
BR2_CCACHE_DIR="/home/ccache"
BR2_REPRODUCIBLE=y
BR2_TOOLCHAIN_EXTERNAL=y
BR2_TOOLCHAIN_EXTERNAL_DOWNLOAD=y
BR2_TOOLCHAIN_EXTERNAL_URL="https://toolchains.bootlin.com/downloads/releases/toolchains/x86-64-core-i7/tarballs/x86-64-core-i7--glibc--bleeding-edge-2020.08-1.tar.bz2"
BR2_TOOLCHAIN_EXTERNAL_HEADERS_5_4=y
BR2_TOOLCHAIN_EXTERNAL_CUSTOM_GLIBC=y
BR2_TOOLCHAIN_EXTERNAL_CXX=y
BR2_TARGET_GENERIC_HOSTNAME="retroroot"
BR2_TARGET_GENERIC_ISSUE="More games for you!"
BR2_INIT_SYSTEMD=y
BR2_SYSTEM_BIN_SH_BASH=y
# BR2_TARGET_GENERIC_GETTY is not set
BR2_SYSTEM_ENABLE_NLS=y
BR2_ROOTFS_OVERLAY="retroroot/board/x86_64/kms/overlay"
BR2_ROOTFS_POST_BUILD_SCRIPT="retroroot/board/x86_64/kms/post-build.sh"
BR2_ROOTFS_POST_IMAGE_SCRIPT="retroroot/board/x86_64/kms/post-image-efi.sh"
BR2_ROOTFS_POST_SCRIPT_ARGS="--data-part-size=1024M --device-type=buildroot-retroroot --generate-mender-image=false --artifact-name=1.0"
BR2_LINUX_KERNEL=y
BR2_LINUX_KERNEL_CUSTOM_VERSION=y
BR2_LINUX_KERNEL_CUSTOM_VERSION_VALUE="5.11"
BR2_LINUX_KERNEL_USE_CUSTOM_CONFIG=y
BR2_LINUX_KERNEL_CUSTOM_CONFIG_FILE="retroroot/board/x86_64/linux.config"
BR2_LINUX_KERNEL_NEEDS_HOST_OPENSSL=y
BR2_LINUX_KERNEL_NEEDS_HOST_LIBELF=y
BR2_PACKAGE_FFMPEG_NONFREE=y
BR2_PACKAGE_FFMPEG_FFPLAY=y
BR2_PACKAGE_GZIP=y
BR2_PACKAGE_UNZIP=y
BR2_PACKAGE_XZ=y
BR2_PACKAGE_ZIP=y
BR2_PACKAGE_FINDUTILS=y
BR2_PACKAGE_GREP=y
BR2_PACKAGE_CIFS_UTILS=y
BR2_PACKAGE_DOSFSTOOLS=y
BR2_PACKAGE_DOSFSTOOLS_FATLABEL=y
BR2_PACKAGE_DOSFSTOOLS_FSCK_FAT=y
BR2_PACKAGE_DOSFSTOOLS_MKFS_FAT=y
BR2_PACKAGE_E2FSPROGS_RESIZE2FS=y
BR2_PACKAGE_E2TOOLS=y
BR2_PACKAGE_ACPID=y
BR2_PACKAGE_CONNMAN=y
BR2_PACKAGE_CONNMAN_WIFI=y
BR2_PACKAGE_CONNMAN_WISPR=y
BR2_PACKAGE_CONNMAN_BLUETOOTH=y
BR2_PACKAGE_CONNMAN_LOOPBACK=y
BR2_PACKAGE_CONNMAN_NEARD=y
BR2_PACKAGE_CONNMAN_OFONO=y
BR2_PACKAGE_CONNMAN_CLIENT=y
BR2_PACKAGE_DHCPCD=y
BR2_PACKAGE_COREUTILS=y
BR2_PACKAGE_COREUTILS_INDIVIDUAL_BINARIES=y
BR2_PACKAGE_OPENVMTOOLS=y
BR2_PACKAGE_OPENVMTOOLS_RESOLUTIONKMS=y
BR2_PACKAGE_SYSTEMD_LOGIND=y
# BR2_PACKAGE_SYSTEMD_TIMESYNCD is not set
BR2_PACKAGE_UTIL_LINUX_SULOGIN=y
BR2_PACKAGE_LESS=y
BR2_PACKAGE_NANO=y
BR2_PACKAGE_VIM=y
BR2_TARGET_ROOTFS_EXT2=y
BR2_TARGET_ROOTFS_EXT2_4=y
BR2_TARGET_ROOTFS_EXT2_LABEL="retro-root"
BR2_TARGET_ROOTFS_EXT2_SIZE="1024M"
BR2_TARGET_ROOTFS_EXT2_MKFS_OPTIONS="-O 64bit"
# BR2_TARGET_ROOTFS_TAR is not set
BR2_TARGET_GRUB2=y
BR2_TARGET_GRUB2_X86_64_EFI=y
BR2_TARGET_GRUB2_BUILTIN_MODULES="boot linux ext2 fat squash4 part_msdos part_gpt normal efi_gop loadenv hashsum echo halt gcry_sha256 test all_video efi_uga video_bochs video_cirrus gzio search search_fs_uuid usb usbms"
BR2_TARGET_GRUB2_INSTALL_TOOLS=y
BR2_PACKAGE_HOST_DOSFSTOOLS=y
BR2_PACKAGE_HOST_GENIMAGE=y
BR2_PACKAGE_HOST_MENDER_ARTIFACT=y
BR2_PACKAGE_HOST_MTOOLS=y
```

## retroroot/fs/dracut/Config.in
```kconfig
config BR2_TARGET_ROOTFS_DRACUT
	bool "dracut initramfs"
	depends on BR2_USE_MMU # dracut -> fork()
	depends on !BR2_STATIC_LIBS # dracut -> kmod
	select BR2_PACKAGE_DRACUT
	help
	  Build a initramfs using dracut

	  https://github.com/dracutdevs/dracut

if BR2_TARGET_ROOTFS_DRACUT

config BR2_TARGET_ROOTFS_DRACUT_HOST_ONLY
	bool "Host only build"
	help
	  Host-Only mode: Install only what is needed for booting the
	  local host instead of a generic host and generate
	  host-specific configuration. This can greatly reduce the size
	  of the image, but won't work on as many systems out of the
	  box.

	  Select this option if you are building for a specific hardware
	  platform and not a generic PC.

if BR2_TARGET_ROOTFS_DRACUT_HOST_ONLY

choice
	prompt "host-only mode"
	default BR2_TARGET_ROOTFS_DRACUT_HOST_ONLY_SLOPPY
	help
	  Select the host-only mode

config BR2_TARGET_ROOTFS_DRACUT_HOST_ONLY_SLOPPY
	bool "sloppy"
	help
	  Extra drivers and modules will be installed, so minor hardware
	  change won't make the image unbootable (eg. changed keyboard),
	  and the image is still portable among similar hosts.

config BR2_TARGET_ROOTFS_DRACUT_HOST_ONLY_STRICT
	bool "strict"
	help
	  Anything not necessary for booting the local host in its
	  current state will not be included, and modules may do
	  some extra job to save more space. Minor change of
	  hardware or environment could make the image unbootable.

endchoice

config BR2_TARGET_ROOTFS_DRACUT_KERNEL_MODULES
	string "Additional kernel modules to include"
	help
	  An optional space seperated list of additional kernel modules
	  of which to include in the initramfs image.

config BR2_PACKAGE_ROOTFS_CONF_PATH
	string "conf file path"
	help
	  An optional path to a dracut conf file

endif # BR2_TARGET_ROOTFS_DRACUT_HOST_ONLY

config BR2_TARGET_ROOTFS_DRACUT_MODULES
	string "Additional dracut modules"
	help
	  Space seperated list of additional dracut modules of which to
	  install. A full list of modules can be found in the modules.d
	  directory of the dracut source code.

config BR2_TARGET_ROOTFS_DRACUT_CUSTOM_KERNEL_CMDLINE
	string "custom kernel command line arguments"
	help
	  Specify custom kernel command line argumets. Leave blank to
	  use the kernel defaults.

config BR2_TARGET_ROOTFS_DRACUT_MOD_SIG
	bool "Module signing support"
	select BR2_PACKAGE_KEYUTILS
	help
	  Select this if your kernel modules are signed.

choice
	prompt "Compression method"
	default BR2_TARGET_ROOTFS_DRACUT_NO_COMPRESSION
	depends on BR2_TARGET_ROOTFS_DRACUT
	help
	  Select compressor for tar archive of the root filesystem

config BR2_TARGET_ROOTFS_DRACUT_NO_COMPRESSION
	bool "no compression"
	help
	  Do not compress the dracut image.

config BR2_TARGET_ROOTFS_DRACUT_GZIP_COMPRESSION
	bool "gzip"
	help
	  Do compress the dracut image with gzip.

config BR2_TARGET_ROOTFS_DRACUT_BZIP2_COMPRESSION
	bool "bzip2"
	help
	  Do compress the dracut image with bzip2.

config BR2_TARGET_ROOTFS_DRACUT_LZ4_COMPRESSION
	bool "lz4"
	help
	  Do compress the dracut image with lz4.

config BR2_TARGET_ROOTFS_DRACUT_LZMA_COMPRESSION
	bool "lzma"
	help
	  Do compress the dracut image with lzma.

config BR2_TARGET_ROOTFS_DRACUT_LZO_COMPRESSION
	bool "lzo"
	help
	  Do compress the dracut image with lzop.

config BR2_TARGET_ROOTFS_DRACUT_XZ_COMPRESSION
	bool "xz"
	help
	  Do compress the dracut image with xz.

config BR2_TARGET_ROOTFS_DRACUT_ZSTD_COMPRESSION
	bool "zstd"
	help
	  Do compress the dracut image with zstd.

endchoice

config BR2_TARGET_ROOTFS_DRACUT_COMPRESSION_METHOD
	string
	default "no-compress"  if BR2_TARGET_ROOTFS_DRACUT_NO_COMPRESSION
	default "gzip"  if BR2_TARGET_ROOTFS_DRACUT_GZIP_COMPRESSION
	default "bzip2"  if BR2_TARGET_ROOTFS_DRACUT_BZIP2_COMPRESSION
	default "lz4"  if BR2_TARGET_ROOTFS_DRACUT_LZ4_COMPRESSION
	default "lzma"  if BR2_TARGET_ROOTFS_DRACUT_LZMA_COMPRESSION
	default "lzo"  if BR2_TARGET_ROOTFS_DRACUT_LZO_COMPRESSION
	default "xz"  if BR2_TARGET_ROOTFS_DRACUT_XZ_COMPRESSION
	default "zstd"  if BR2_TARGET_ROOTFS_DRACUT_ZSTD_COMPRESSION

endif

comment "dracut needs a toolchain w/ dynamic library"
	depends on BR2_USE_MMU
	depends on BR2_STATIC_LIBS
```
